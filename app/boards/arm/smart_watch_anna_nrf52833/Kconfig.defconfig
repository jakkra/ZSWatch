## app/boards/arm/smart_watch_anna_nrf52833/Kconfig.defconfig
```kconfig
# Copyright (c) 2022 Nordic Semiconductor ASA
# SPDX-License-Identifier: Apache-2.0

if BOARD_SMART_WATCH_ANNA_NRF52833

config BOARD
	default "smart_watch_anna_nrf52833"

config BT_CTLR
   default BT

endif
```

## app/boards/arm/zswatch_nrf5340/zswatch_nrf5340_cpuapp_defconfig
```kconfig
# SPDX-License-Identifier: Apache-2.0

CONFIG_SOC_SERIES_NRF53X=y
CONFIG_SOC_NRF5340_CPUAPP_QKAA=y
CONFIG_BOARD_ZSWATCH_NRF5340_CPUAPP=y

CONFIG_ZBUS=y
CONFIG_ZBUS_RUNTIME_OBSERVERS=y
CONFIG_ZBUS_CHANNEL_NAME=y
CONFIG_ZBUS_OBSERVER_NAME=y

CONFIG_SENSOR=y

CONFIG_INPUT=y

CONFIG_DISPLAY=y

# Enable MPU
CONFIG_ARM_MPU=y

# Enable hardware stack protection
CONFIG_HW_STACK_PROTECTION=y

# Enable TrustZone-M
CONFIG_ARM_TRUSTZONE_M=y

CONFIG_GPIO=y
CONFIG_I2C=y
CONFIG_ADC=y
CONFIG_PWM=y
CONFIG_SPI=y

# Enable console
CONFIG_CONSOLE=y
CONFIG_UART_CONSOLE=y

# Enable uart driver
CONFIG_SERIAL=y

CONFIG_PINCTRL=y

CONFIG_CLOCK_CONTROL_NRF_K32SRC_RC=y
# Ensure GPIO P0.01 and P0.00 can be used
CONFIG_SOC_ENABLE_LFXO=n

CONFIG_BMP581=y
```

## app/boards/arm/zswatch_nrf5340/zswatch_nrf5340_cpunet_defconfig
```kconfig
# SPDX-License-Identifier: Apache-2.0

CONFIG_SOC_SERIES_NRF53X=y
CONFIG_SOC_NRF5340_CPUNET_QKAA=y
CONFIG_BOARD_ZSWATCH_NRF5340_CPUNET=y

# Enable MPU
CONFIG_ARM_MPU=y

# Enable hardware stack protection
CONFIG_HW_STACK_PROTECTION=y

# Enable GPIO
CONFIG_GPIO=y

CONFIG_PINCTRL=y

# This board does not have external
CONFIG_CLOCK_CONTROL_NRF_K32SRC_RC=y
# Ensure GPIO P0.01 and P0.00 can be used
CONFIG_SOC_ENABLE_LFXO=n
```

## app/drivers/display/Kconfig.gc9a01
```kconfig
# GC9A01 display controller configuration options

config GC9A01
	bool "GC9A01 compatible display controller driver"
	default y
	select SPI
	help
	  Enable driver for GC9A01 compatible controller.
```

## app/drivers/display/gc9a01/Kconfig
```kconfig
menuconfig GC9A01
    bool "GC9A01 Display"
    default n
    select SPI
    help
        Enable driver for GC9A01 compatible controller.
```

## app/drivers/rtc/rv8263c8/Kconfig
```kconfig
# SPDX-License-Identifier: Apache-2.0
# Copyright (c) 2024 Daniel Kampert
# Author: Daniel Kampert <DanielKampert@Kampis-Elektroecke.de>

config RTC_RV8263
	bool "Micro Crystal RV-8263-C8 RTC driver"
	default y
	depends on DT_HAS_MICROCRYSTAL_RV_8263_C8_ENABLED
	select I2C
	help
	    Micro Crystal RV-8263-C8 RTC driver.

if RTC_RV8263
    menu "RV8263 Update"
		depends on RTC_UPDATE

        choice
            prompt "RV-8263-C8 update handling mode"
            default RTC_RV8263_UPDATE_GLOBAL_THREAD

            config RTC_RV8263_UPDATE_GLOBAL_THREAD
                depends on GPIO
                bool "Use workqueue (Default)"
                help
                    Use the global workqueue to process the updates from the RV-8263-C8.

            config RTC_RV8263_UPDATE_OWN_THREAD
                depends on GPIO
                bool "Use driver thread"
                help
                    Use a separate thread to process the updates from the RV-8263-C8.
        endchoice

        config RTC_RV8263_UPDATE_THREAD_STACK_SIZE
            int "Stack size for the RV-8263-C8 update thread"
            depends on RTC_RV8263_UPDATE_OWN_THREAD
            default 512
            help
                Size of the stack used for the thread handling RTC updates and dispatching callbacks.

        config RTC_RV8263_UPDATE_THREAD_PRIORITY
            int "RV-8263-C8 update thread priority"
            depends on RTC_RV8263_UPDATE_OWN_THREAD
            default 0
            help
                Priority level for the thread handling RTC updates and dispatching callbacks.
    endmenu

    menu "RV8263 Alarm"
        depends on RTC_ALARM

        choice
            prompt "RV-8263-C8 alarm handling mode"
            default RTC_RV8263_ALARM_GLOBAL_THREAD

            config RTC_RV8263_ALARM_GLOBAL_THREAD
                depends on GPIO
                bool "Use workqueue (Default)"
                help
                    Use the global workqueue to process the interrupts from the RV-8263-C8.

            config RTC_RV8263_ALARM_OWN_THREAD
                depends on GPIO
                bool "Use driver thread"
                help
                    Use a separate thread to process the alarms from the RV-8263-C8.
        endchoice

        config RTC_RV8263_ALARM_THREAD_STACK_SIZE
            int "Stack size for the RV-8263-C8 interrupt thread"
            depends on RTC_RV8263_ALARM_OWN_THREAD
            default 512
            help
                Size of the stack used for the thread handling alarms and dispatching callbacks.

        config RTC_RV8263_ALARM_THREAD_PRIORITY
            int "RV-8263-C8 alarm thread priority"
            depends on RTC_RV8263_ALARM_OWN_THREAD
            default 0
            help
                Priority level for the thread handling alarms and dispatching callbacks.
    endmenu
endif
```

## app/drivers/sensor/apds9306/Kconfig
```kconfig
# APDS-9306 light sensor configuration options.

# Copyright (c) 2023, Daniel Kampert
#
# SPDX-License-Identifier: Apache-2.0

config APDS9306
	bool "APDS9306 light sensor"
	default y
	select I2C
	help
	  Enable the driver for the APDS9306 digital light sensor.
```

## app/drivers/sensor/bmi270/Kconfig
```kconfig
# APDS-9306 light sensor configuration options.

# Copyright (c) 2023, Daniel Kampert
#
# SPDX-License-Identifier: Apache-2.0

menuconfig BMI270
    bool "BMI270 Sensor"
    default y
    select I2C
    help
        Enable the driver for the BMI270 IMU.

if BMI270
    config BMI270_TRIGGER
        bool
endif
```

## app/drivers/sensor/bmp581/Kconfig
```kconfig
# APDS-9306 light sensor configuration options.

# Copyright (c) 2023, Daniel Kampert
#
# SPDX-License-Identifier: Apache-2.0

menuconfig BMP581
    bool "BMP581 Sensor"
    default y
    select I2C
    help
        Enable the driver for the BMP581 pressure sensor.

if BMP581

endif
```

## boards/arm/smart_watch_anna_nrf52833/Kconfig.board
```kconfig
# Copyright (c) 2022 Nordic Semiconductor ASA
# SPDX-License-Identifier: Apache-2.0

config BOARD_SMART_WATCH_ANNA_NRF52833
	bool "smart_watch_anna_nrf52833"
	depends on SOC_NRF52833_QIAA
```

## boards/arm/smart_watch_anna_nrf52833/smart_watch_anna_nrf52833_defconfig
```kconfig
# Copyright (c) 2022 Nordic Semiconductor ASA
# SPDX-License-Identifier: Apache-2.0

CONFIG_SOC_SERIES_NRF52X=y
CONFIG_SOC_NRF52833_QIAA=y
CONFIG_BOARD_SMART_WATCH_ANNA_NRF52833=y

# Enable MPU
CONFIG_ARM_MPU=y

# Enable hardware stack protection
CONFIG_HW_STACK_PROTECTION=y

# additional board options
CONFIG_GPIO_AS_PINRESET=y

CONFIG_PINCTRL=y
```
